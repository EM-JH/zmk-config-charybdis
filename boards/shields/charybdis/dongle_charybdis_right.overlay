/*
 * Copyright (c) 2024 The ZMK Contributors
 * SPDX-License-Identifier: MIT
 * 
 * Charybdis right keyboard - Peripheral mode (for use with dongle)
 * Forwards trackball input to central device
 */

#include "charybdis_right_common.dtsi"

/ {
    // Forward trackball input from peripheral to central (dongle)
    input_split: input_split@0 {
        compatible = "zmk,input-split";
        status = "okay";
        device = <&trackball>;
        reg = <0 1>;  // address 0, size 1
    };
/* --- 여기서부터 내가 준 코드가 붙는 기라 --- */
    vbatt: vbatt {
        compatible = "zmk,battery-voltage-divider";
        label = "BATTERY";
        io-channels = <&adc 2>;      
        output-ohms = <2000000>;    
        full-ohms = <3000000>;      
    };

    chosen {
        zmk,battery = &vbatt;       
    };
};
